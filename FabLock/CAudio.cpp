/* 
* CAudio.cpp
*
* Created: 07.01.2018 18:17:28
* Author: Marcel Jongmanns
*/

#include <avr/io.h>
#include <avr/pgmspace.h>
#include "CAudio.h"

// constants
const uint16_t freqLUT[64] PROGMEM = {
	0,
	369, // f = 55.0
	391, // f = 58.2704701898
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	13257, // f = 1975.53320502
};

const int8_t sineLUT[256] PROGMEM = {
	0, 3, 6, 9, 12, 15, 18, 21, 24, 28, 31, 34, 37, 40, 43, 46, 48, 51, 54, 57, 60, 63, 65, 68, 71, 73,
	76, 78, 81, 83, 85, 88, 90, 92, 94, 96, 98, 100, 102, 104, 106, 108, 109, 111, 112, 114, 115, 117, 118,
	119, 120, 121, 122, 123, 124, 124, 125, 126, 126, 127, 127, 127, 127, 127, 127, 127, 127, 127, 127, 127,
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	-51, -48, -46, -43, -40, -37, -34, -31, -28, -24, -21, -18, -15, -12, -9, -6, -3,
};

// Yakety Sax - Key missing
const lied_t PROGMEM lied1[] = {
	{52, 4}, {49, 1}, {47, 3}, {40, 2}, {40, 2}, {37, 1}, {35, 3}, {49, 1}, {43, 2}, {40, 1}, {42, 2}, {40, 2}, {0, 4}, {47, 4}, {52, 2},
	{52, 2}, {49, 1}, {47, 1}, {44, 1}, {40, 1}, {47, 2}, {49, 2}, {47, 1}, {44, 1}, {40, 1}, {37, 1}, {40, 2}, {40, 1}, {42, 1}, {44, 1},
	{47, 1}, {49, 1}, {47, 1}, {52, 4}, {0, 1}, {47, 1}, {49, 1}, {51, 1}, {52, 2}, {52, 2}, {49, 1}, {47, 1}, {44, 1}, {40, 1}, {47, 2},
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	{64, 0}};

// Spanish flea - window opening/closing
const lied_t PROGMEM lied2[] = {
	{40, 4}, {47, 4}, {35, 4}, {47, 2}, {47, 2}, {40, 4}, {47, 2}, {35, 2}, {35, 2}, {35, 2}, {47, 4}, {40, 4}, {47, 2}, {47, 2}, {35, 4},
	{47, 2}, {47, 2}, {40, 4}, {0, 4}, {0, 2}, {32, 2}, {33, 2}, {34, 2}, {35, 4}, {44, 2}, {35, 2}, {44, 2}, {42, 2}, {0, 2}, {41, 10},
	{0, 2}, {37, 2}, {36, 2}, {35, 2}, {34, 4}, {42, 2}, {34, 2}, {42, 2}, {40, 2}, {0, 2}, {39, 10}, {0, 2}, {35, 2},
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	{64, 0}};

		
enum note {
	nPAUSE = 0, nA1, nAis1, nB1,
	nC2, nCis2, nD2, nDis2, nE2, nF2, nFis2, nG2, nGis2, nA2, nAis2, nB2,
	nC3, nCis3, nD3, nDis3, nE3, nF3, nFis3, nG3, nGis3, nA3, nAis3, nB3,
	nC4, nCis4, nD4, nDis4, nE4, nF4, nFis4, nG4, nGis4, nA4, nAis4, nB4,
	nC5, nCis5, nD5, nDis5, nE5, nF5, nFis5, nG5, nGis5, nA5, nAis5, nB5,
	nC6, nCis6, nD6, nDis6, nE6, nF6, nFis6, nG6, nGis6, nA6, nAis6, nB6,
	nENDE
};

// default constructor
CAudio::CAudio()
{
	this->phase = 0;
	this->frequency = 0;
	this->isPlaying = 0;
	this->pos = 0;
	this->song = 0;
} //CAudio

// default destructor
CAudio::~CAudio()
{
} //~CAudio

void CAudio::init()
{
	// Timer 1 -> 9.6kHz samplerate
	TCCR1A = 0;
	TCCR1B = _BV(WGM12) | _BV(CS00);
	OCR1A = 833;
	TIMSK1 = _BV(OCIE1A);
	
	// Timer 2 -> PWM
	TCCR2A = _BV(COM2B1) | _BV(WGM21) | _BV(WGM20);
	TCCR2B = _BV(CS20);
	OCR2B = 0x80;
}

void CAudio::start(uint8_t freq)
{
	if(freq < nENDE)
	{
		this->frequency = pgm_read_word(&freqLUT[freq]);
	}
	else
	{
		this->frequency = 0;
	}
}

void CAudio::stop()
{
	this->frequency = 0;
	OCR2B = 0x80;
}

void CAudio::onTimer()
{
	int8_t amp;
	
	this->phase += this->frequency;
	amp = (int8_t)pgm_read_byte(&sineLUT[this->phase >> 8]);
	
	if(this->frequency)
	{
		OCR2B = ((uint16_t)0x200 + amp) >> 2;
	}
	else
	{
		//OCR2B = 0x80;
	}
}

void CAudio::stopSong()
{
	this->isPlaying = 0;
	this->frequency = 0;
	OCR2B = 0x80;
}

void CAudio::playSong1()
{
	if(this->isPlaying)
	{
		return;
	}
	
	this->pos = 0;
	this->len = 0;
	this->isPlaying = 1;
	this->song = lied1;
}

void CAudio::playSong2()
{
	if(this->isPlaying)
	{
		return;
	}
	
	this->pos = 0;
	this->len = 0;
	this->isPlaying = 1;
	this->song = lied2;
}

void CAudio::step()
{
	static uint8_t wasSpacing = 0;
	uint8_t note;
	
	// return is not playing
	if(!this->isPlaying || this->song == 0)
	{
		return;
	}
	
	if(!this->len)
	{
		// create pause between notes
		if(!wasSpacing)
		{
			this->frequency = 0;
			this->len = 1;
			wasSpacing = 1;
			return;
		}
		
		note = pgm_read_byte(&this->song[this->pos].n);
		
		// song over -> repeat
		if(note >= nENDE)
		{
			this->pos = 0;
			this->frequency = 0;
			this->len = 1;
			return;
		}
		
		this->frequency = pgm_read_word(&freqLUT[note]);
		this->len = pgm_read_word(&this->song[this->pos].l);
		wasSpacing = 0;
		
		this->pos++;
	}
	else
	{
		this->len--;
	}
}